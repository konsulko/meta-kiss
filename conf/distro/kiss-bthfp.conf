## conf/distro/kiss-bthfp.conf
```bitbake
# Distribution definition for: kiss-bthfp
#
# Copyright 2017 Konsulko Group
#
# This file is released under the MIT license as described in
# ../meta/COPYING.MIT.

DISTRO = "kiss-bthfp"
DISTROOVERRIDES = "kiss:kiss-bthfp"

DISTRO_FEATURES_remove = " acl argp ext2 irda largefile pcmcia usbgadget xattr nfs zeroconf pci nfc ipv6 wifi x11"
DISTRO_FEATURES_append = " systemd pam pulseaudio"
DISTRO_FEATURES_BACKFILL_CONSIDERED = "sysvinit"

VIRTUAL-RUNTIME_init_manager = "systemd"
VIRTUAL-RUNTIME_initscripts = ""

IMAGE_FSTYPES = "tar.bz2"

#PNBLACKLIST[core-image-sato] = "not buildable with poky-tiny"
```
